## meta-iris/conf/distro/poky-iris-fsl.conf
```bitbake
#
# Copyright 2019 Arcus Project
#
# Licensed under the Apache License, Version 2.0 (the "License");
# you may not use this file except in compliance with the License.
# You may obtain a copy of the License at
#
#   http://www.apache.org/licenses/LICENSE-2.0
#
# Unless required by applicable law or agreed to in writing, software
# distributed under the License is distributed on an "AS IS" BASIS,
# WITHOUT WARRANTIES OR CONDITIONS OF ANY KIND, either express or implied.
# See the License for the specific language governing permissions and
# limitations under the License.
#

require conf/distro/poky.conf

DISTRO = "poky-iris-fsl"

IRIS_DISTRO_FEATURES_DEFAULT ?= "argp ext2 largefile usbhost xattr multiarch \
			     udev alsa rtc bluetooth bluez5"

# Platform specific applications
CORE_IMAGE_EXTRA_INSTALL += "alsa-utils-amixer alsa-utils-speakertest sox \
			     wpa-supplicant linux-wifi-firmware \
			     iw busybox-hwclock iris-nfc"

# Leave for now, can be cleaned up later
IRIS_DISTRO_FEATURES_LIBC_DEFAULT ?= "ipv4 ipv6 libc-backtrace \
		libc-charsets libc-crypt libc-crypt-ufc libc-fcvt \
		libc-ftraverse libc-getlogin libc-inet-anl \
		libc-libm libc-locales libc-locale-code libc-memusage libc-nis \
		libc-rcmd libc-spawn libc-streams libc-sunrpc libc-utmp \
		libc-utmpx libc-wordexp libc-posix-clang-wchar \
		libc-posix-regexp libc-posix-regexp-glibc libc-posix-wchar-io \
		libc-big-macros libc-bsd libc-cxx-tests libc-catgets \
		libc-db-aliases libc-envz libc-fmtmsg libc-fstab libc-idn \
		libc-nsswitch libc-rtld-debug"

IRIS_DISTRO_FEATURES_LIBC = "${IRIS_DISTRO_FEATURES_LIBC_DEFAULT}"
DISTRO_FEATURES_LIBC_class-nativesdk = "${IRIS_DISTRO_FEATURES_LIBC_DEFAULT}"

DISTRO_FEATURES = "${IRIS_DISTRO_FEATURES_DEFAULT} ${IRIS_DISTRO_FEATURES_LIBC}"

PREFERRED_PROVIDER_jpeg = "jpeg"
PREFERRED_PROVIDER_jpeg-native = "jpeg-native"
PREFERRED_PROVIDER_make-native = "make-native"

# We use the stock u-boot with our mods
PREFERRED_PROVIDER_u-boot = "u-boot"

# We want a squashfs rootfs
IMAGE_FSTYPES += "tar.bz2 squashfs"

# Remove imx firmware packages we don't need
MACHINE_FIRMWARE_remove = "firmware-imx-vpu-imx6q firmware-imx-vpu-imx6d firmware-imx-epdc"

# Needed for sox support for MP3, etc. playback
LICENSE_FLAGS_WHITELIST = "commercial"
```

## meta-iris/conf/distro/poky-iris-ti.conf
```bitbake
#
# Copyright 2019 Arcus Project
#
# Licensed under the Apache License, Version 2.0 (the "License");
# you may not use this file except in compliance with the License.
# You may obtain a copy of the License at
#
#   http://www.apache.org/licenses/LICENSE-2.0
#
# Unless required by applicable law or agreed to in writing, software
# distributed under the License is distributed on an "AS IS" BASIS,
# WITHOUT WARRANTIES OR CONDITIONS OF ANY KIND, either express or implied.
# See the License for the specific language governing permissions and
# limitations under the License.
#

require conf/distro/poky.conf

DISTRO = "poky-iris-ti"

IRIS_DISTRO_FEATURES_DEFAULT ?= "argp ext2 ipv4 ipv6 largefile usbhost xattr multiarch udev"

DISTRO_FEATURES = "${IRIS_DISTRO_FEATURES_DEFAULT}"

DISTRO_FEATURES:remove = "opengl"

PREFERRED_PROVIDER_jpeg = "jpeg"
PREFERRED_PROVIDER_jpeg-native = "jpeg-native"
PREFERRED_PROVIDER_make-native = "make-native"

# Prevent beaglebone-yocto machine from pulling in U-Boot build
EXTRA_IMAGEDEPENDS:remove = "virtual/bootloader"

# Use 6.6 kernel
PREFERRED_VERSION_linux-yocto = "6.6%"

# We want a squashfs rootfs
IMAGE_FSTYPES = "tar.bz2 squashfs"

# Limit to our single console port to avoid trying to start up another
SERIAL_CONSOLES = "115200;ttyS0"

# Remove bluez5 support as we do not use it
DISTRO_FEATURES_BACKFILL_CONSIDERED = "bluez5"

# Also remove rtc support which is not on this hardware
MACHINE_FEATURES_BACKFILL_CONSIDERED = "rtc"

# Make sure no kernel-image-zimage is appended, we still use uImage
IMAGE_INSTALL:remove = "kernel-image-zimage"

# Show gateway URI in build configuration output
BUILDCFG_VARS += "IRIS_GATEWAY_URI"
```

## meta-iris/conf/layer.conf
```bitbake
#
# Copyright 2019 Arcus Project
#
# Licensed under the Apache License, Version 2.0 (the "License");
# you may not use this file except in compliance with the License.
# You may obtain a copy of the License at
#
#   http://www.apache.org/licenses/LICENSE-2.0
#
# Unless required by applicable law or agreed to in writing, software
# distributed under the License is distributed on an "AS IS" BASIS,
# WITHOUT WARRANTIES OR CONDITIONS OF ANY KIND, either express or implied.
# See the License for the specific language governing permissions and
# limitations under the License.
#

# We have a conf and classes directory, add to BBPATH
BBPATH .= ":${LAYERDIR}"

# We have recipes-* directories, add to BBFILES
BBFILES += "${LAYERDIR}/recipes-*/*/*.bb \
	${LAYERDIR}/recipes-*/*/*.bbappend"

BBFILE_COLLECTIONS += "iris"
BBFILE_PATTERN_iris = "^${LAYERDIR}/"
BBFILE_PRIORITY_iris = "6"

LICENSE_PATH += "${LAYERDIR}/licenses"
```

## meta-iris/conf/machine/imxdimagic.conf
```bitbake
#@TYPE: Machine
#@NAME: Freescale i.MX6DL Iris V3 Hub
#@SOC: i.MX6DL
#@DESCRIPTION: Machine configuration for Freescale i.MX6DL Iris V3 Hub
#@MAINTAINER: 

MACHINEOVERRIDES =. "mx6:mx6dl:mx6q:"

require conf/machine/include/imx-base.inc
require conf/machine/include/arm/armv7a/tune-cortexa9.inc

SERIAL_CONSOLE = "115200 ttymxc0"

MACHINE_FEATURES += " pci wifi bluetooth"

# Remove vfat for GPLv3 license issues
MACHINE_FEATURES:remove = "vfat"

SOC_FAMILY = "mx6:mx6q"

# Set specific make target and binary suffix
PREFERRED_PROVIDER_u-boot ??= "u-boot-imxgs"
PREFERRED_PROVIDER_virtual/bootloader ??= "u-boot-imxgs"

KERNEL_DEVICETREE = "nxp/imx/imx6dl-imagic.dtb nxp/imx/imx6q-imagic.dtb"

# Override imx-base.inc defaults — Hub V3 uses raw partitions, not wic
IMAGE_FSTYPES = "tar.gz"
WKS_FILE = ""

UBOOT_CONFIG ??= "sd"
UBOOT_CONFIG[sd] = "mx6dlimagic_config,sdcard"
```

## meta-iris/recipes-kernel/linux/linux-fslc-lts/imxdimagic/defconfig
```kconfig
#
# Hub V3 (i.MX6DL IMAGIC) defconfig for linux-fslc-lts 6.6
# Based on imx_v6_v7_defconfig with Hub V3 customizations.
#
CONFIG_KERNEL_LZO=y
CONFIG_SYSVIPC=y
CONFIG_NO_HZ_IDLE=y
CONFIG_HIGH_RES_TIMERS=y
CONFIG_PREEMPT_VOLUNTARY=y
CONFIG_IKCONFIG=y
CONFIG_IKCONFIG_PROC=y
CONFIG_LOG_BUF_SHIFT=18
CONFIG_RELAY=y
CONFIG_BLK_DEV_INITRD=y
CONFIG_EXPERT=y
CONFIG_PERF_EVENTS=y
# CONFIG_SLUB_DEBUG is not set
# CONFIG_COMPAT_BRK is not set
CONFIG_MODULES=y
CONFIG_MODULE_UNLOAD=y
CONFIG_MODVERSIONS=y
CONFIG_MODULE_SRCVERSION_ALL=y
CONFIG_ARCH_MULTI_V6=y
CONFIG_ARCH_MXC=y
# CONFIG_SOC_IMX31 is not set
# CONFIG_SOC_IMX35 is not set
# CONFIG_SOC_IMX50 is not set
# CONFIG_SOC_IMX51 is not set
# CONFIG_SOC_IMX53 is not set
CONFIG_SOC_IMX6Q=y
# CONFIG_SOC_IMX6SL is not set
# CONFIG_SOC_IMX6SLL is not set
# CONFIG_SOC_IMX6SX is not set
# CONFIG_SOC_IMX6UL is not set
# CONFIG_SOC_IMX7D is not set
# CONFIG_SOC_IMX7ULP is not set
CONFIG_SOC_VF610=y
CONFIG_SMP=y
CONFIG_ARM_PSCI=y
CONFIG_HIGHMEM=y
CONFIG_ARCH_FORCE_MAX_ORDER=13
CONFIG_CMDLINE="noinitrd console=ttymxc0,115200"
CONFIG_KEXEC=y
CONFIG_CPU_FREQ=y
CONFIG_CPU_FREQ_STAT=y
CONFIG_CPU_FREQ_DEFAULT_GOV_ONDEMAND=y
CONFIG_CPU_FREQ_GOV_POWERSAVE=y
CONFIG_CPU_FREQ_GOV_USERSPACE=y
CONFIG_CPU_FREQ_GOV_CONSERVATIVE=y
CONFIG_CPUFREQ_DT=y
CONFIG_ARM_IMX6Q_CPUFREQ=y
CONFIG_CPU_IDLE=y
CONFIG_ARM_CPUIDLE=y
CONFIG_VFP=y
CONFIG_NEON=y
CONFIG_PM_DEBUG=y
CONFIG_PM_TEST_SUSPEND=y

# Networking
CONFIG_NET=y
CONFIG_PACKET=y
CONFIG_UNIX=y
CONFIG_INET=y
CONFIG_IP_PNP=y
CONFIG_IP_PNP_DHCP=y
CONFIG_IPV6=y
CONFIG_NETFILTER=y

# Bluetooth
CONFIG_BT=y
CONFIG_BT_BNEP=m
CONFIG_BT_HCIUART=y
CONFIG_BT_HCIUART_H4=y
CONFIG_BT_HCIUART_LL=y

# WiFi
CONFIG_CFG80211=y
CONFIG_CFG80211_WEXT=y
CONFIG_MAC80211=y
CONFIG_RFKILL=y
CONFIG_RFKILL_INPUT=y

# PCI (for PCIe WiFi/modems)
CONFIG_PCI=y
CONFIG_PCI_MSI=y
CONFIG_PCI_IMX6_HOST=y

CONFIG_DEVTMPFS=y
CONFIG_DEVTMPFS_MOUNT=y
# CONFIG_STANDALONE is not set
CONFIG_IMX_WEIM=y
CONFIG_CONNECTOR=y

# MTD
CONFIG_MTD=y
CONFIG_MTD_CMDLINE_PARTS=y
CONFIG_MTD_BLOCK=y
CONFIG_MTD_CFI=y
CONFIG_MTD_JEDECPROBE=y
CONFIG_MTD_CFI_INTELEXT=y
CONFIG_MTD_CFI_AMDSTD=y
CONFIG_MTD_CFI_STAA=y
CONFIG_MTD_PHYSMAP=y
CONFIG_MTD_PHYSMAP_OF=y
CONFIG_MTD_DATAFLASH=y
CONFIG_MTD_SST25L=y
CONFIG_MTD_RAW_NAND=y
CONFIG_MTD_NAND_GPMI_NAND=y
CONFIG_MTD_NAND_VF610_NFC=y
CONFIG_MTD_NAND_MXC=y
CONFIG_MTD_SPI_NOR=y
CONFIG_MTD_UBI=y
CONFIG_MTD_UBI_FASTMAP=y
CONFIG_MTD_UBI_BLOCK=y

# Block devices
CONFIG_BLK_DEV_LOOP=y
CONFIG_BLK_DEV_RAM=y
CONFIG_BLK_DEV_RAM_SIZE=65536
CONFIG_EEPROM_AT24=y
CONFIG_EEPROM_AT25=y

# SCSI / disk
# CONFIG_SCSI_PROC_FS is not set
CONFIG_BLK_DEV_SD=y
# CONFIG_BLK_DEV_BSG is not set
CONFIG_SCSI_CONSTANTS=y
CONFIG_SCSI_LOGGING=y
CONFIG_SCSI_SCAN_ASYNC=y

# ATA
CONFIG_ATA=y
CONFIG_SATA_AHCI_PLATFORM=y
CONFIG_AHCI_IMX=y
CONFIG_PATA_IMX=y

# Network devices
CONFIG_NETDEVICES=y
CONFIG_PHYLIB=y
CONFIG_SMSC_PHY=y
CONFIG_AT803X_PHY=y
CONFIG_MICREL_PHY=y
CONFIG_SMC91X=y
CONFIG_SMC911X=y
CONFIG_SMSC911X=y

# USB networking
CONFIG_USB_USBNET=y
CONFIG_USB_NET_QMI_WWAN=y
CONFIG_USB_NET_CDCETHER=y

# WiFi drivers (Broadcom AP6181)
CONFIG_WLAN_VENDOR_BROADCOM=y
CONFIG_BRCMFMAC=m

# Input (minimal — headless hub)
CONFIG_INPUT_MISC=y
CONFIG_INPUT_UINPUT=y
# CONFIG_INPUT_KEYBOARD is not set
# CONFIG_INPUT_MOUSE is not set
# CONFIG_INPUT_TOUCHSCREEN is not set

# Serial
# CONFIG_LEGACY_PTYS is not set
CONFIG_SERIAL_IMX=y
CONFIG_SERIAL_IMX_CONSOLE=y
CONFIG_SERIAL_FSL_LPUART=y
CONFIG_SERIAL_FSL_LPUART_CONSOLE=y
CONFIG_SERIAL_DEV_BUS=y

# I2C
CONFIG_I2C=y
# CONFIG_I2C_COMPAT is not set
CONFIG_I2C_CHARDEV=y
CONFIG_I2C_MUX=y
CONFIG_I2C_MUX_GPIO=y
# CONFIG_I2C_HELPER_AUTO is not set
CONFIG_I2C_IMX=y

# SPI
CONFIG_SPI=y
CONFIG_SPI_GPIO=y
CONFIG_SPI_IMX=y
CONFIG_SPI_SPIDEV=y

# GPIO
CONFIG_GPIO_SYSFS=y
CONFIG_GPIO_MXC=y
CONFIG_GPIO_PCA953X=y
CONFIG_GPIO_STMPE=y

# Power
CONFIG_POWER_RESET=y
CONFIG_POWER_RESET_SYSCON=y
CONFIG_POWER_RESET_SYSCON_POWEROFF=y
CONFIG_POWER_SUPPLY=y

# Thermal / sensors
CONFIG_SENSORS_GPIO_FAN=y
CONFIG_SENSORS_IIO_HWMON=y
CONFIG_THERMAL_WRITABLE_TRIPS=y
CONFIG_CPU_THERMAL=y
CONFIG_IMX_THERMAL=y

# Watchdog
CONFIG_WATCHDOG=y
CONFIG_WATCHDOG_CORE=y
CONFIG_WATCHDOG_NOWAYOUT=y
CONFIG_SOFT_WATCHDOG=m
CONFIG_IMX2_WDT=y

# MFD
CONFIG_MFD_DA9052_I2C=y
CONFIG_MFD_MC13XXX_SPI=y
CONFIG_MFD_MC13XXX_I2C=y
CONFIG_MFD_STMPE=y

# Regulators
CONFIG_REGULATOR=y
CONFIG_REGULATOR_FIXED_VOLTAGE=y
CONFIG_REGULATOR_ANATOP=y
CONFIG_REGULATOR_DA9052=y
CONFIG_REGULATOR_GPIO=y
CONFIG_REGULATOR_MC13783=y
CONFIG_REGULATOR_MC13892=y

# Display / GPU — DISABLED (headless hub)
# CONFIG_DRM is not set
# CONFIG_FB is not set
# CONFIG_BACKLIGHT_CLASS_DEVICE is not set
# CONFIG_FRAMEBUFFER_CONSOLE is not set
# CONFIG_LOGO is not set

# Media — DISABLED
# CONFIG_MEDIA_SUPPORT is not set

# Sound
CONFIG_SOUND=y
CONFIG_SND=y
# CONFIG_SND_USB_AUDIO is not set
CONFIG_SND_SOC=y
CONFIG_SND_IMX_SOC=y
CONFIG_SND_SOC_FSL_SSI=y
CONFIG_SND_SOC_FSL_UTILS=y
CONFIG_SND_SOC_IMX_AUDMUX=y
CONFIG_SND_SOC_IMX_PCM_DMA=y
CONFIG_SND_SOC_NAU8810=y
CONFIG_SND_SOC_IMX_NAU8810=y

# USB
CONFIG_USB=y
# CONFIG_USB_OTG_WHITELIST is not set
CONFIG_USB_EHCI_HCD=y
CONFIG_USB_ACM=y
CONFIG_USB_STORAGE=y
CONFIG_USB_CHIPIDEA=y
CONFIG_USB_CHIPIDEA_UDC=y
CONFIG_USB_CHIPIDEA_HOST=y
CONFIG_USB_SERIAL=y
CONFIG_USB_SERIAL_GENERIC=y
CONFIG_USB_SERIAL_CP210X=y
CONFIG_USB_SERIAL_FTDI_SIO=m
CONFIG_USB_SERIAL_PL2303=y
CONFIG_USB_SERIAL_OPTION=y
CONFIG_NOP_USB_XCEIV=y
CONFIG_USB_MXS_PHY=y

# MMC
CONFIG_MMC=y
CONFIG_MMC_SDHCI=y
CONFIG_MMC_SDHCI_PLTFM=y
CONFIG_MMC_SDHCI_ESDHC_IMX=y
CONFIG_MMC_BLOCK_MINORS=16

# LEDs
CONFIG_NEW_LEDS=y
CONFIG_LEDS_CLASS=y
CONFIG_LEDS_GPIO=y
CONFIG_LEDS_TRIGGERS=y
CONFIG_LEDS_TRIGGER_TIMER=y
CONFIG_LEDS_TRIGGER_ONESHOT=y

# RTC
CONFIG_RTC_CLASS=y
CONFIG_RTC_INTF_DEV_UIE_EMUL=y
CONFIG_RTC_DRV_DS1307=y
CONFIG_RTC_DRV_PCF8563=y
CONFIG_RTC_DRV_SNVS=y

# DMA
CONFIG_DMADEVICES=y
CONFIG_IMX_SDMA=y
CONFIG_MXS_DMA=y
CONFIG_DMA_ENGINE=y
CONFIG_DMA_VIRTUAL_CHANNELS=y

# PWM
CONFIG_PWM=y
CONFIG_PWM_FSL_FTM=y
CONFIG_PWM_IMX27=y

# NVMEM
CONFIG_NVMEM_IMX_OCOTP=y

# Filesystems
CONFIG_EXT2_FS=y
CONFIG_EXT2_FS_XATTR=y
CONFIG_EXT2_FS_POSIX_ACL=y
CONFIG_EXT2_FS_SECURITY=y
CONFIG_EXT3_FS=y
CONFIG_EXT3_FS_POSIX_ACL=y
CONFIG_EXT3_FS_SECURITY=y
CONFIG_EXT4_FS=y
CONFIG_EXT4_FS_POSIX_ACL=y
CONFIG_EXT4_FS_SECURITY=y
CONFIG_AUTOFS_FS=y
CONFIG_FUSE_FS=y
CONFIG_CUSE=y
CONFIG_VFAT_FS=y
CONFIG_TMPFS=y
CONFIG_SQUASHFS=y
CONFIG_SQUASHFS_FILE_CACHE=y
CONFIG_SQUASHFS_DECOMP_SINGLE=y
CONFIG_SQUASHFS_XATTR=y
CONFIG_SQUASHFS_ZLIB=y
CONFIG_SQUASHFS_XZ=y
CONFIG_SQUASHFS_EMBEDDED=y
CONFIG_SQUASHFS_FRAGMENT_CACHE_SIZE=10

# NLS
CONFIG_NLS_DEFAULT="cp437"
CONFIG_NLS_CODEPAGE_437=y
CONFIG_NLS_ASCII=y
CONFIG_NLS_ISO8859_1=y
CONFIG_NLS_UTF8=y

# Crypto
CONFIG_CRYPTO_MD5=y
CONFIG_CRYPTO_SHA1=y
CONFIG_CRYPTO_SHA256=y
CONFIG_CRYPTO_SHA512=y
CONFIG_CRYPTO_DES=y
CONFIG_CRYPTO_HW=y
CONFIG_CRYPTO_DEV_FSL_CAAM=y
CONFIG_CRYPTO_DEV_FSL_CAAM_JR=y
CONFIG_CRYPTO_DEV_FSL_CAAM_CRYPTO_API=y
CONFIG_CRYPTO_DEV_FSL_CAAM_AHASH_API=y
CONFIG_CRYPTO_DEV_FSL_CAAM_RNG_API=y
CONFIG_HW_RANDOM=y
CONFIG_CRYPTO_DEV_MXS_DCP=y
CONFIG_CRYPTO_USER=y
CONFIG_CRYPTO_USER_API_AEAD=y
CONFIG_CRYPTO_USER_API_HASH=y
CONFIG_CRYPTO_USER_API_RNG=y
CONFIG_CRYPTO_USER_API_SKCIPHER=y

# CRC
CONFIG_CRC_CCITT=y
CONFIG_CRC_T10DIF=y

# Debug (minimal)
# CONFIG_DEBUG_FS is not set
# CONFIG_MAGIC_SYSRQ is not set
# CONFIG_SCHED_DEBUG is not set
# CONFIG_DEBUG_BUGVERBOSE is not set
# CONFIG_FTRACE is not set

# IMAGIC Hub V3 custom drivers
CONFIG_IMAGIC_WATCH_DOG=y
CONFIG_BUZZER=y
CONFIG_IMX6_GPIO_TEST=y
CONFIG_MBI6023=y

# FIQ needed for SSI audio
CONFIG_FIQ=y
CONFIG_SND_SOC_IMX_PCM_FIQ=y

# i.MX6 errata
CONFIG_ARM_ERRATA_814220=y
```

## radios/ble/zephyr/boards/arm/nrf52_pca10040/Kconfig.defconfig
```kconfig
# Kconfig - nRF52 PCA10040 board configuration
#
# Copyright (c) 2016 Nordic Semiconductor ASA
#
# SPDX-License-Identifier: Apache-2.0

if BOARD_NRF52_PCA10040

config BOARD
	default "nrf52_pca10040"

if GPIO_NRF5

config GPIO_NRF5_P0
	default y

endif # GPIO_NRF5

if UART_NRF5

config UART_NRF5_GPIO_TX_PIN
	default 13

config UART_NRF5_GPIO_RX_PIN
	default 14

config UART_NRF5_GPIO_RTS_PIN
	default 11

config UART_NRF5_GPIO_CTS_PIN
	default 12

endif # UART_NRF5

endif # BOARD_NRF52_PCA10040
```
